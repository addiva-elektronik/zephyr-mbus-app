## CMakeLists.txt
```
cmake_minimum_required(VERSION 3.20)

list(APPEND BOARD_ROOT ${CMAKE_CURRENT_SOURCE_DIR}/..)
list(APPEND SHIELD mikroe_mbus_click)

find_package(Zephyr REQUIRED HINTS $ENV{ZEPHYR_BASE})
project(app)

target_sources(app PRIVATE src/main.c)
```

## west.yml
```
# See the west documentation for more information:
#
# https://developer.nordicsemi.com/nRF_Connect_SDK/doc/latest/zephyr/guides/west/index.html

manifest:
  self:
    path: mbus-app

  # List of git repositories which make up the application
  projects:
    - name: nrf
      url: https://github.com/nrfconnect/sdk-nrf
      # IMPORTANT: When changing NCS revision you need to sync the
      # revision of the Zephyr project below so it matches.
      revision: v2.1.0
      import:
        name-allowlist:
          # Ignore NCS private repos, keep this list sorted alphabetically.
          #- cirrus
          #- cjson
          #- cmock
          #- find-my
          #- homekit
          #- matter
          #- mbedtls-nrf
          #- mcuboot
          #- memfault-firmware-sdk
          #- nrf-802154
          - nrfxlib
          - openthread
          #- sdk-lc3
          #- tfm-mcuboot
          #- trusted-firmware-m
          #- unity
          #- zcbor
          # Ignore zephyr as it is added below manually (to filter)
          # - zephyr

    - name: zephyr
      url: https://github.com/nrfconnect/sdk-zephyr
      revision: v3.1.99-ncs1
      import:
        # In addition to the zephyr repository itself, NCS also imports
        # the contents of zephyr/west.yml at the above revision. Only
        # the projects explicitly named in the following allowlist are
        # imported.
        #
        # Note that the zephyr west extensions (like 'build', 'flash',
        # 'debug', etc.) are automatically provided by this import, so
        # there's no need to add a redundant west-commands: key for
        # the zephyr project.
        #
        # Please keep this list sorted alphabetically.
        name-allowlist:
          #- TraceRecorderSource
          #- canopennode
          #- chre
          #- civetweb
          - cmsis
          #- edtt
          #- fatfs
          #- fff
          - hal_nordic
          #- hal_st  # Hal for ST's sensors, not for MCU's
          #- liblc3codec
          #- libmetal
          - littlefs
          - loramac-node
          #- lvgl
          #- lz4
          #- mbedtls
          #- mipi-sys-t
          #- nanopb
          - net-tools
          - nrf_hw_models
          #- open-amp
          #- picolibc
          #- psa-arch-tests
          #- segger
          #- tinycbor
          #- tinycrypt
          #- tf-m-tests
          #- zscbor
          #- zscilib

    - name: mbus
      url: https://github.com/addiva-elektronik/zephyr-mbus-module
      revision: main
      submodules: true
      path: modules/lib/mbus
```

## prj.conf
```kconfig
#
# System
#
CONFIG_LOG=y
CONFIG_LOG_DEFAULT_LEVEL=3
CONFIG_HWINFO=y
CONFIG_SHELL=y
CONFIG_HEAP_MEM_POOL_SIZE=16385
CONFIG_MAIN_STACK_SIZE=2048
CONFIG_SYSTEM_WORKQUEUE_STACK_SIZE=2048
CONFIG_MINIMAL_LIBC_MALLOC_ARENA_SIZE=32768

#
# POSIX API
#
CONFIG_POSIX_MAX_FDS=4
CONFIG_POSIX_API=y
# CONFIG_POSIX_MQUEUE is not set

#
# Dummy modules to silence below Zephyr/CMake/CAF warning
#
CONFIG_LED=y
CONFIG_PWM=y
CONFIG_LED_PWM=y

#
# Common Application Framework
#
CONFIG_CAF=y
# Needed to silence this build error when only CAF is enabled:
# CMake Warning at ~/src/zephyr-mbus-app/zephyr/CMakeLists.txt:831:
#   No SOURCES given to Zephyr library: ..__nrf__subsys__caf__modules
CONFIG_CAF_LEDS=y
CONFIG_CAF_LEDS_PWM=y

#
# Settings subsystem
#
CONFIG_FLASH=y
CONFIG_NVS=y
CONFIG_FLASH_MAP=y
CONFIG_SETTINGS=y
CONFIG_SETTINGS_SHELL=y

#
# M-Bus module's Kconfig depends on SERIAL, UART, and RING_BUFFER
#
CONFIG_MBUS=y
```

## nordic.overlay
```dts
&uart1 {
        compatible = "nordic,nrf-uarte";
        label = "mbus0";
        current-speed = <2400>;
        status = "okay";
};

/ {
        aliases {
                mbus0 = &uart1;
        };
};
```

## src/main.c
```c
/* M-Bus master module for Zephyr
 *
 * Copyright (C) 2022  Addiva Elektronik AB
 *
 * Author: Joachim Wiberg <joachim.wiberg@addiva.se>
 */
#define MODULE main

#include <zephyr/logging/log.h>
#include <caf/events/module_state_event.h>
#include <zephyr/settings/settings.h>

LOG_MODULE_REGISTER(MODULE);

int main(void)
{
    /* Start CAF and signal that main have completed system setup */
    if (app_event_manager_init()) {
        LOG_ERR("Application Event Manager not initialized!");
        return 1;
    }

    settings_subsys_init();
    settings_load();

    LOG_DBG("Event manager initialized.");
    module_set_state(MODULE_STATE_READY);

    return 0;
}

/**
 * Local Variables:
 *  indent-tabs-mode: nil
 *  c-file-style: "stroustrup"
 * End:
 */
```
